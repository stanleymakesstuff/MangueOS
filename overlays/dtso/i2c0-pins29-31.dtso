// SPDX-License-Identifier: (GPL-2.0+ OR MIT)
// Mangue OS header overlay i2c0-pins29-31 — GENERATED by tools/gen_overlays.py,
// edit overlays/header_table.py instead.
//
// pin port  role
//  31 PB11  sda
//  29 PB10  scl
// device: /dev/i2c-0

/dts-v1/;
/plugin/;

#include <dt-bindings/gpio/gpio.h>
#include <dt-bindings/interrupt-controller/irq.h>
#include <dt-bindings/input/linux-event-codes.h>

&pio {
	mq_i2c0_pins29_31_pins: i2c0-pins29-31-pins {
		pins = "PB11", "PB10";
		function = "i2c0";
		bias-pull-up;
	};
};

&i2c0 {
	pinctrl-names = "default";
	pinctrl-0 = <&mq_i2c0_pins29_31_pins>;
	clock-frequency = <100000>;
	status = "okay";
};
