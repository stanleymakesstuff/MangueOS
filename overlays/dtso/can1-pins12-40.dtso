// SPDX-License-Identifier: (GPL-2.0+ OR MIT)
// Mangue OS header overlay can1-pins12-40 — GENERATED by tools/gen_overlays.py,
// edit overlays/header_table.py instead.
//
// pin port  role
//  40 PB4   tx
//  12 PB5   rx
// device: network interface canN (ip link set canN up type can bitrate ...)
// Needs an external 3.3 V CAN transceiver (e.g. SN65HVD230). Classic CAN, no FD.

/dts-v1/;
/plugin/;

#include <dt-bindings/gpio/gpio.h>
#include <dt-bindings/interrupt-controller/irq.h>
#include <dt-bindings/input/linux-event-codes.h>

&can1 {
	status = "okay";
};
