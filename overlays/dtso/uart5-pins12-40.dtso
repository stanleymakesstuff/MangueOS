// SPDX-License-Identifier: (GPL-2.0+ OR MIT)
// Mangue OS header overlay uart5-pins12-40 — GENERATED by tools/gen_overlays.py,
// edit overlays/header_table.py instead.
//
// pin port  role
//  40 PB4   tx
//  12 PB5   rx
// device: /dev/ttyS5

/dts-v1/;
/plugin/;

#include <dt-bindings/gpio/gpio.h>
#include <dt-bindings/interrupt-controller/irq.h>
#include <dt-bindings/input/linux-event-codes.h>

&pio {
	mq_uart5_pins12_40_pins: uart5-pins12-40-pins {
		pins = "PB4", "PB5";
		function = "uart5";
		bias-pull-up;
	};
};

&uart5 {
	pinctrl-names = "default";
	pinctrl-0 = <&mq_uart5_pins12_40_pins>;
	status = "okay";
};
