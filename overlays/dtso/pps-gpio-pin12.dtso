// SPDX-License-Identifier: (GPL-2.0+ OR MIT)
// Mangue OS header overlay pps-gpio-pin12 — GENERATED by tools/gen_overlays.py,
// edit overlays/header_table.py instead.
//
// pin port  role
//  12 PB5   pps
// device: /dev/ppsN

/dts-v1/;
/plugin/;

#include <dt-bindings/gpio/gpio.h>
#include <dt-bindings/interrupt-controller/irq.h>
#include <dt-bindings/input/linux-event-codes.h>

&{/} {
	pps-gpio-pin12 {
		compatible = "pps-gpio";
		gpios = <&pio 1 5 (GPIO_ACTIVE_HIGH)>;
	};
};
