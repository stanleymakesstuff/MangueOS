// SPDX-License-Identifier: (GPL-2.0+ OR MIT)
// Mangue OS header overlay i2c3-pins7-35 — GENERATED by tools/gen_overlays.py,
// edit overlays/header_table.py instead.
//
// pin port  role
//   7 PB7   sda
//  35 PB6   scl
// device: /dev/i2c-3

/dts-v1/;
/plugin/;

#include <dt-bindings/gpio/gpio.h>
#include <dt-bindings/interrupt-controller/irq.h>
#include <dt-bindings/input/linux-event-codes.h>

&pio {
	mq_i2c3_pins7_35_pins: i2c3-pins7-35-pins {
		pins = "PB7", "PB6";
		function = "i2c3";
		bias-pull-up;
	};
};

&i2c3 {
	pinctrl-names = "default";
	pinctrl-0 = <&mq_i2c3_pins7_35_pins>;
	clock-frequency = <100000>;
	status = "okay";
};
