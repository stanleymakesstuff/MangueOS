// SPDX-License-Identifier: (GPL-2.0+ OR MIT)
// Mangue OS header overlay i2c3-pins27-28 — GENERATED by tools/gen_overlays.py,
// edit overlays/header_table.py instead.
//
// pin port  role
//  27 PE17  sda
//  28 PE16  scl
// device: /dev/i2c-3
// Pins 27/28 are 2.8 V I/O (board pull-ups to 3.3 V). Open-drain I2C only: no 3.3 V push-pull signals, no extra pull-ups.

/dts-v1/;
/plugin/;

#include <dt-bindings/gpio/gpio.h>
#include <dt-bindings/interrupt-controller/irq.h>
#include <dt-bindings/input/linux-event-codes.h>

&pio {
	mq_i2c3_pins27_28_pins: i2c3-pins27-28-pins {
		pins = "PE17", "PE16";
		function = "i2c3";
	};
};

&i2c3 {
	pinctrl-names = "default";
	pinctrl-0 = <&mq_i2c3_pins27_28_pins>;
	clock-frequency = <100000>;
	status = "okay";
};
