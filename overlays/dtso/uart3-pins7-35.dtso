// SPDX-License-Identifier: (GPL-2.0+ OR MIT)
// Mangue OS header overlay uart3-pins7-35 — GENERATED by tools/gen_overlays.py,
// edit overlays/header_table.py instead.
//
// pin port  role
//  35 PB6   tx
//   7 PB7   rx
// device: /dev/ttyS3

/dts-v1/;
/plugin/;

#include <dt-bindings/gpio/gpio.h>
#include <dt-bindings/interrupt-controller/irq.h>
#include <dt-bindings/input/linux-event-codes.h>

&pio {
	mq_uart3_pins7_35_pins: uart3-pins7-35-pins {
		pins = "PB6", "PB7";
		function = "uart3";
		bias-pull-up;
	};
};

&uart3 {
	pinctrl-names = "default";
	pinctrl-0 = <&mq_uart3_pins7_35_pins>;
	status = "okay";
};
