// SPDX-License-Identifier: (GPL-2.0+ OR MIT)
// Mangue OS header overlay dht11-pin7 — GENERATED by tools/gen_overlays.py,
// edit overlays/header_table.py instead.
//
// pin port  role
//   7 PB7   data
// device: /sys/bus/iio/devices/iio:deviceN

/dts-v1/;
/plugin/;

#include <dt-bindings/gpio/gpio.h>
#include <dt-bindings/interrupt-controller/irq.h>
#include <dt-bindings/input/linux-event-codes.h>

&{/} {
	dht11-pin7 {
		compatible = "dht11";
		gpios = <&pio 1 7 (GPIO_ACTIVE_HIGH)>;
	};
};
