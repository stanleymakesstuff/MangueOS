// SPDX-License-Identifier: (GPL-2.0+ OR MIT)
// Mangue OS header overlay uart4-pins36-38 — GENERATED by tools/gen_overlays.py,
// edit overlays/header_table.py instead.
//
// pin port  role
//  36 PB2   tx
//  38 PB3   rx
// device: /dev/ttyS4

/dts-v1/;
/plugin/;

#include <dt-bindings/gpio/gpio.h>
#include <dt-bindings/interrupt-controller/irq.h>
#include <dt-bindings/input/linux-event-codes.h>

&pio {
	mq_uart4_pins36_38_pins: uart4-pins36-38-pins {
		pins = "PB2", "PB3";
		function = "uart4";
		bias-pull-up;
	};
};

&uart4 {
	pinctrl-names = "default";
	pinctrl-0 = <&mq_uart4_pins36_38_pins>;
	status = "okay";
};
