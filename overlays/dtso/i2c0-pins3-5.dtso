// SPDX-License-Identifier: (GPL-2.0+ OR MIT)
// Mangue OS header overlay i2c0-pins3-5 — GENERATED by tools/gen_overlays.py,
// edit overlays/header_table.py instead.
//
// pin port  role
//   3 PG13  sda
//   5 PG12  scl
// device: /dev/i2c-0

/dts-v1/;
/plugin/;

#include <dt-bindings/gpio/gpio.h>
#include <dt-bindings/interrupt-controller/irq.h>
#include <dt-bindings/input/linux-event-codes.h>

&pio {
	mq_i2c0_pins3_5_pins: i2c0-pins3-5-pins {
		pins = "PG13", "PG12";
		function = "i2c0";
	};
};

&i2c0 {
	pinctrl-names = "default";
	pinctrl-0 = <&mq_i2c0_pins3_5_pins>;
	clock-frequency = <100000>;
	status = "okay";
};
