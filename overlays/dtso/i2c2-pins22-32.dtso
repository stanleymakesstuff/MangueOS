// SPDX-License-Identifier: (GPL-2.0+ OR MIT)
// Mangue OS header overlay i2c2-pins22-32 — GENERATED by tools/gen_overlays.py,
// edit overlays/header_table.py instead.
//
// pin port  role
//  22 PC1   sda
//  32 PC0   scl
// device: /dev/i2c-2

/dts-v1/;
/plugin/;

#include <dt-bindings/gpio/gpio.h>
#include <dt-bindings/interrupt-controller/irq.h>
#include <dt-bindings/input/linux-event-codes.h>

&pio {
	mq_i2c2_pins22_32_pins: i2c2-pins22-32-pins {
		pins = "PC1", "PC0";
		function = "i2c2";
		bias-pull-up;
	};
};

&i2c2 {
	pinctrl-names = "default";
	pinctrl-0 = <&mq_i2c2_pins22_32_pins>;
	clock-frequency = <100000>;
	status = "okay";
};
