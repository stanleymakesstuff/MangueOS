// SPDX-License-Identifier: (GPL-2.0+ OR MIT)
// Mangue OS header overlay w1-gpio-pin7 — GENERATED by tools/gen_overlays.py,
// edit overlays/header_table.py instead.
//
// pin port  role
//   7 PB7   data
// device: /sys/bus/w1/devices
// 1-Wire (DS18B20 ...); external 4.7 k pull-up to 3.3 V required

/dts-v1/;
/plugin/;

#include <dt-bindings/gpio/gpio.h>
#include <dt-bindings/interrupt-controller/irq.h>
#include <dt-bindings/input/linux-event-codes.h>

&{/} {
	w1-gpio-pin7 {
		compatible = "w1-gpio";
		gpios = <&pio 1 7 (GPIO_ACTIVE_HIGH)>;
	};
};
