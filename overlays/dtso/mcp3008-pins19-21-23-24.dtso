// SPDX-License-Identifier: (GPL-2.0+ OR MIT)
// Mangue OS header overlay mcp3008-pins19-21-23-24 — GENERATED by tools/gen_overlays.py,
// edit overlays/header_table.py instead.
//
// pin port  role
//  19 PD12  mosi
//  21 PD13  miso
//  23 PD11  clk
//  24 PD10  cs0
// device: /sys/bus/iio/devices/iio:deviceN
// IIO driver (/sys/bus/iio); use spi1-pins19-21-23-24 instead for spidev access

/dts-v1/;
/plugin/;

#include <dt-bindings/gpio/gpio.h>
#include <dt-bindings/interrupt-controller/irq.h>
#include <dt-bindings/input/linux-event-codes.h>

&pio {
	mq_mcp3008_pins19_21_23_24_pins: mcp3008-pins19-21-23-24-pins {
		pins = "PD12", "PD13", "PD11", "PD10";
		function = "spi1";
	};
};

&spi1 {
	pinctrl-names = "default";
	pinctrl-0 = <&mq_mcp3008_pins19_21_23_24_pins>;
	#address-cells = <1>;
	#size-cells = <0>;
	status = "okay";

	adc@0 {
		compatible = "microchip,mcp3008";
		reg = <0>;
		spi-max-frequency = <1000000>;
		vref-supply = <&reg_vcc_3v3>;
		#io-channel-cells = <1>;
	};
};
