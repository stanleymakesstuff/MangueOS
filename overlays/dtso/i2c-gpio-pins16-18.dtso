// SPDX-License-Identifier: (GPL-2.0+ OR MIT)
// Mangue OS header overlay i2c-gpio-pins16-18 — GENERATED by tools/gen_overlays.py,
// edit overlays/header_table.py instead.
//
// pin port  role
//  16 PB1   sda
//  18 PD14  scl
// device: /dev/i2c-N (first free number >= 4; HDMI DDC also takes one; see i2cdetect -l)
// bit-banged, ~100 kHz; bus number is the first free one >= 4 (see i2cdetect -l)

/dts-v1/;
/plugin/;

#include <dt-bindings/gpio/gpio.h>
#include <dt-bindings/interrupt-controller/irq.h>
#include <dt-bindings/input/linux-event-codes.h>

&{/} {
	i2c-gpio-pins16-18 {
		compatible = "i2c-gpio";
		sda-gpios = <&pio 1 1 (GPIO_ACTIVE_HIGH | GPIO_OPEN_DRAIN | GPIO_PULL_UP)>;
		scl-gpios = <&pio 3 14 (GPIO_ACTIVE_HIGH | GPIO_OPEN_DRAIN | GPIO_PULL_UP)>;
		i2c-gpio,delay-us = <5>;
		#address-cells = <1>;
		#size-cells = <0>;
	};
};
