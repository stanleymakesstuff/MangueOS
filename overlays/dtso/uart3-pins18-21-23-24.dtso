// SPDX-License-Identifier: (GPL-2.0+ OR MIT)
// Mangue OS header overlay uart3-pins18-21-23-24 — GENERATED by tools/gen_overlays.py,
// edit overlays/header_table.py instead.
//
// pin port  role
//  24 PD10  tx
//  23 PD11  rx
//  21 PD13  rts
//  18 PD14  cts
// device: /dev/ttyS3
// with RTS/CTS flow control

/dts-v1/;
/plugin/;

#include <dt-bindings/gpio/gpio.h>
#include <dt-bindings/interrupt-controller/irq.h>
#include <dt-bindings/input/linux-event-codes.h>

&pio {
	mq_uart3_pins18_21_23_24_pins: uart3-pins18-21-23-24-pins {
		pins = "PD10", "PD11", "PD13", "PD14";
		function = "uart3";
		bias-pull-up;
	};
};

&uart3 {
	pinctrl-names = "default";
	pinctrl-0 = <&mq_uart3_pins18_21_23_24_pins>;
	uart-has-rtscts;
	status = "okay";
};
