// SPDX-License-Identifier: (GPL-2.0+ OR MIT)
// Mangue OS header overlay i2c2-pins15-16 — GENERATED by tools/gen_overlays.py,
// edit overlays/header_table.py instead.
//
// pin port  role
//  16 PB1   sda
//  15 PB0   scl
// device: /dev/i2c-2

/dts-v1/;
/plugin/;

#include <dt-bindings/gpio/gpio.h>
#include <dt-bindings/interrupt-controller/irq.h>
#include <dt-bindings/input/linux-event-codes.h>

&pio {
	mq_i2c2_pins15_16_pins: i2c2-pins15-16-pins {
		pins = "PB1", "PB0";
		function = "i2c2";
		bias-pull-up;
	};
};

&i2c2 {
	pinctrl-names = "default";
	pinctrl-0 = <&mq_i2c2_pins15_16_pins>;
	clock-frequency = <100000>;
	status = "okay";
};
