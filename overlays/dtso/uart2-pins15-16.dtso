// SPDX-License-Identifier: (GPL-2.0+ OR MIT)
// Mangue OS header overlay uart2-pins15-16 — GENERATED by tools/gen_overlays.py,
// edit overlays/header_table.py instead.
//
// pin port  role
//  15 PB0   tx
//  16 PB1   rx
// device: /dev/ttyS2

/dts-v1/;
/plugin/;

#include <dt-bindings/gpio/gpio.h>
#include <dt-bindings/interrupt-controller/irq.h>
#include <dt-bindings/input/linux-event-codes.h>

&pio {
	mq_uart2_pins15_16_pins: uart2-pins15-16-pins {
		pins = "PB0", "PB1";
		function = "uart2";
		bias-pull-up;
	};
};

&uart2 {
	pinctrl-names = "default";
	pinctrl-0 = <&mq_uart2_pins15_16_pins>;
	status = "okay";
};
