// SPDX-License-Identifier: (GPL-2.0+ OR MIT)
// Mangue OS header overlay gpio-ir-pin12 — GENERATED by tools/gen_overlays.py,
// edit overlays/header_table.py instead.
//
// pin port  role
//  12 PB5   rx
// device: /dev/lirc0 + input device

/dts-v1/;
/plugin/;

#include <dt-bindings/gpio/gpio.h>
#include <dt-bindings/interrupt-controller/irq.h>
#include <dt-bindings/input/linux-event-codes.h>

&{/} {
	gpio-ir-pin12 {
		compatible = "gpio-ir-receiver";
		gpios = <&pio 1 5 (GPIO_ACTIVE_LOW)>;
		linux,rc-map-name = "rc-rc6-mce";
	};
};
