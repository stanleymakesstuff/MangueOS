// SPDX-License-Identifier: (GPL-2.0+ OR MIT)
// Mangue OS header overlay gpio-shutdown-pin5 — GENERATED by tools/gen_overlays.py,
// edit overlays/header_table.py instead.
//
// pin port  role
//   5 PG12  button
// device: KEY_POWER -> systemd-logind poweroff
// button to GND on pin 5 = clean shutdown (pin has a board pull-up)

/dts-v1/;
/plugin/;

#include <dt-bindings/gpio/gpio.h>
#include <dt-bindings/interrupt-controller/irq.h>
#include <dt-bindings/input/linux-event-codes.h>

&{/} {
	gpio-shutdown-pin5 {
		compatible = "gpio-keys";

		shutdown {
			label = "Shutdown";
			linux,code = <KEY_POWER>;
			gpios = <&pio 6 12 (GPIO_ACTIVE_LOW)>;
			debounce-interval = <100>;
		};
	};
};
