// SPDX-License-Identifier: (GPL-2.0+ OR MIT)
// Mangue OS header overlay i2c1-pins12-40 — GENERATED by tools/gen_overlays.py,
// edit overlays/header_table.py instead.
//
// pin port  role
//  12 PB5   sda
//  40 PB4   scl
// device: /dev/i2c-1

/dts-v1/;
/plugin/;

#include <dt-bindings/gpio/gpio.h>
#include <dt-bindings/interrupt-controller/irq.h>
#include <dt-bindings/input/linux-event-codes.h>

&pio {
	mq_i2c1_pins12_40_pins: i2c1-pins12-40-pins {
		pins = "PB5", "PB4";
		function = "i2c1";
		bias-pull-up;
	};
};

&i2c1 {
	pinctrl-names = "default";
	pinctrl-0 = <&mq_i2c1_pins12_40_pins>;
	clock-frequency = <100000>;
	status = "okay";
};
