// SPDX-License-Identifier: (GPL-2.0+ OR MIT)
// Mangue OS header overlay uart2-pins22-32 — GENERATED by tools/gen_overlays.py,
// edit overlays/header_table.py instead.
//
// pin port  role
//  32 PC0   tx
//  22 PC1   rx
// device: /dev/ttyS2

/dts-v1/;
/plugin/;

#include <dt-bindings/gpio/gpio.h>
#include <dt-bindings/interrupt-controller/irq.h>
#include <dt-bindings/input/linux-event-codes.h>

&pio {
	mq_uart2_pins22_32_pins: uart2-pins22-32-pins {
		pins = "PC0", "PC1";
		function = "uart2";
		bias-pull-up;
	};
};

&uart2 {
	pinctrl-names = "default";
	pinctrl-0 = <&mq_uart2_pins22_32_pins>;
	status = "okay";
};
