// SPDX-License-Identifier: (GPL-2.0+ OR MIT)
// Mangue OS header overlay can0-pins36-38 — GENERATED by tools/gen_overlays.py,
// edit overlays/header_table.py instead.
//
// pin port  role
//  36 PB2   tx
//  38 PB3   rx
// device: network interface canN (ip link set canN up type can bitrate ...)
// Needs an external 3.3 V CAN transceiver (e.g. SN65HVD230). Classic CAN, no FD.

/dts-v1/;
/plugin/;

#include <dt-bindings/gpio/gpio.h>
#include <dt-bindings/interrupt-controller/irq.h>
#include <dt-bindings/input/linux-event-codes.h>

&can0 {
	status = "okay";
};
